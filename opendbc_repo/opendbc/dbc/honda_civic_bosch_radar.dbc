VERSION "honda_civic_bosch_radar -- 36802-TBA Bosch coarse selected-lead. Hand-written (NOT generated; named without _generated so it is git-tracked and loaded via the file fallback, like acura_ilx_2016_nidec.dbc). Bit positions/widths/endianness/sign VALIDATED across 6 rlog routes (2026-06-07, RLOG-RADAR-INGEST-CONFIRM.md). SCALE DISCIPLINE: REL_SPEED LSB=0.25 m/s locked (Bosch std, static cal cannot solve it); LONG_DIST/LAT_DIST factor are PLACEHOLDER/DO_NOT_TRUST pending R0 tape-measure calibration (atom A4). PHYSICAL BUS = openpilot CanBus.camera (rlog src=2), NOT CanBus.radar -- reconfirm via read-only sniff before trusting dRel. The frame counter/checksum are carried as CNTR/CHKSUM (NOT COUNTER/CHECKSUM) on purpose -- opendbc auto-enforces the hardcoded Honda checksum/counter on honda_* DBCs and would DROP every frame if this radar's algo/positions differ; this is RX-only lead data so we decode unconditionally and skip that enforcement."

NS_ :

BS_:

BU_: RADAR XXX

BO_ 712 RADAR_SELECTED_0: 8 RADAR
 SG_ LONG_DIST : 7|16@0+ (1,0) [0|65535] "m" XXX
 SG_ LONG_DIST_HI : 7|8@0+ (1,0) [0|255] "" XXX
 SG_ NEAR_DIST : 23|8@0+ (1,0) [0|255] "" XXX
 SG_ FLAGS_B3 : 31|8@0+ (1,0) [0|255] "" XXX
 SG_ LAT_DIST : 39|16@0+ (1,-32768) [-32768|32767] "m" XXX
 SG_ REL_SPEED : 55|8@0+ (0.25,-31.25) [-31.25|32.5] "m/s" XXX
 SG_ CNTR : 63|4@0+ (1,0) [0|15] "" XXX
 SG_ CHKSUM : 59|4@0+ (1,0) [0|15] "" XXX

BO_ 713 RADAR_SELECTED_1: 8 RADAR
 SG_ LONG_DIST : 7|16@0+ (1,0) [0|65535] "m" XXX
 SG_ LONG_DIST_HI : 7|8@0+ (1,0) [0|255] "" XXX
 SG_ NEAR_DIST : 23|8@0+ (1,0) [0|255] "" XXX
 SG_ FLAGS_B3 : 31|8@0+ (1,0) [0|255] "" XXX
 SG_ LAT_DIST : 39|16@0+ (1,-32768) [-32768|32767] "m" XXX
 SG_ REL_SPEED : 55|8@0+ (0.25,-31.25) [-31.25|32.5] "m/s" XXX
 SG_ CNTR : 63|4@0+ (1,0) [0|15] "" XXX
 SG_ CHKSUM : 59|4@0+ (1,0) [0|15] "" XXX

CM_ "Stock 36802-TBA Bosch radar coarse selected-lead protocol. Big-endian (Motorola). Last byte B7 = two 4-bit fields CNTR/CHKSUM (rolling counter + Honda-style checksum per rlog decode). CNTR/CHKSUM are decoded but UNUSED by openpilot and NOT safety-enforced (renamed from COUNTER/CHECKSUM precisely to avoid opendbc's honda_* auto-enforcement); exact nibble assignment is cosmetic and not relied upon. No-target sentinel: LONG_DIST_HI==0xFF (B0=0xFF, with LAT raw 0x8000 and REL raw 0x7D). LONG_DIST_HI intentionally overlaps LONG_DIST (B0) as a scale-invariant sentinel -- opendbc decodes overlapping signals independently. 0x280-0x2FF per-object bank exists (richer track list) but is OUT of Phase-1 scope.";
CM_ BO_ 712 "SELECTED lead/near object (track 0). REL_SPEED B6 center 0x7D confirmed by range-rate correlation r=+0.80.";
CM_ BO_ 713 "SELECTED lead 1 (track 1), same layout as 712.";
CM_ SG_ 712 LONG_DIST "B0:B1 BE, monotonic with lead range. factor=1 is PLACEHOLDER -> R0 calibration (A4) deduces clean LSB + folds radar->bumper mount into offset. DO_NOT_TRUST until A4.";
CM_ SG_ 712 LONG_DIST_HI "B0 high byte, raw unscaled. Used as the no-target sentinel (==0xFF -> no lead).";
CM_ SG_ 712 NEAR_DIST "B2 near-field range stripe (carries signal when target very close and B0 pins low). Optional/future. DO_NOT_TRUST scale.";
CM_ SG_ 712 LAT_DIST "B4:B5 BE offset-binary, raw 0x8000=center encoded as offset -32768. factor=1 PLACEHOLDER -> A4 sets m/LSB. yRel = -LAT_DIST (left positive). DO_NOT_TRUST until A4.";
CM_ SG_ 712 REL_SPEED "B6 offset-binary, raw 0x7D=0 encoded as offset -31.25. LSB 0.25 m/s LOCKED (Bosch std). SIGN (closing<0) pending A4 dynamic verify drive.";
